## main/Kconfig.projbuild
```kconfig
menu "Project Configuration"

    config WIFI_SSID
        string "WiFi SSID"
        default ""
        help
            SSID of your WiFi network.

    config WIFI_PASSWORD
        string "WiFi Password"
        default ""
        help
            Password of your WiFi network.

    config WIFI_MAXIMUM_RETRY
        int "WiFi Maximum Retry. 0 for indefinite retries."
        default 0
        help
            Maximum number of retries to connect to WiFi.

    config DISCORD_BOT_TOKEN
        string "Discord Bot Token"
        default ""
        help
            Your Discord Bot Token.

    config DANBOORU_LOGIN
        string "Danbooru Login"
        default ""
        help
            Your Danbooru username/login.

    config DANBOORU_API_KEY
        string "Danbooru API Key"
        default ""
        help
            Your Danbooru API Key.

    config LED_GPIO
        int "LED GPIO Pin"
        default 2
        help
            GPIO pin for the onboard LED.

    config LED_INVERTED
        bool "LED Polarity Inverted (Active Low)"
        default n
        help
            Set to 'y' if the LED is on when the GPIO is LOW.

    config BLINK_LED_STRIP
        bool "Whether the LED is ARGB as opposed to simple LED"
        default n
        help
            Set to 'y' if the LED is ARGB. RMT only.

    config ESP32_S3_LCD_1_9
        bool "Using ESP32-S3-LCD-1.9 board"
        default n
        help
            Set to 'y' if using the ESP32-S3-LCD-1.9 board.

endmenu
```

## sdkconfig.defaults
```kconfig
CONFIG_ESPTOOLPY_FLASHSIZE_4MB=y
CONFIG_ESPTOOLPY_FLASHSIZE="4MB"
CONFIG_COMPILER_OPTIMIZATION_SIZE=y
CONFIG_PARTITION_TABLE_SINGLE_APP_LARGE=y

# FreeRTOS task monitoring
CONFIG_FREERTOS_USE_TRACE_FACILITY=y
CONFIG_FREERTOS_USE_STATS_FORMATTING_FUNCTIONS=y

# Certificate Bundle and TLS 1.3
CONFIG_MBEDTLS_CERTIFICATE_BUNDLE=y
CONFIG_MBEDTLS_CERTIFICATE_BUNDLE_DEFAULT_FULL=y
CONFIG_MBEDTLS_CERTIFICATE_BUNDLE_CROSS_SIGNED_VERIFY=y
CONFIG_MBEDTLS_SSL_PROTO_TLS1_3=y
```
